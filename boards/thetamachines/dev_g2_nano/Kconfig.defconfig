## boards/thetamachines/dev_g2_nano/Kconfig.defconfig
```kconfig
# Copyright 2026 Theta Machines
# SPDX-License-Identifier: Apache-2.0

if BOARD_DEV_G2_NANO
    if WIFI
        config WIFI_NXP
            default y

        choice NXP_WIFI_PART
            default NXP_IW416
        endchoice

        config NET_MGMT_EVENT_STACK_SIZE
            default 2048
    endif

    choice BT_NXP_MODULE
        default BT_NXP_IW416
    endchoice

    # Default to "no storage" for the settings subsystem
    choice SETTINGS_BACKEND
        default SETTINGS_NONE
    endchoice
endif
```

## boards/thetamachines/dev_g2_nano/Kconfig.dev_g2_nano
```kconfig
# Copyright 2026 Theta Machines
# SPDX-License-Identifier: Apache-2.0

config BOARD_DEV_G2_NANO
    select SOC_PART_NUMBER_MIMXRT1176DVMAA
    select SOC_MIMXRT1176_CM7
```

## boards/thetamachines/dev_g2_nano/board.yml
```yaml
boards:
  - name: dev_g2_nano
    full_name: G2 Nano
    vendor: thetamachines
    socs:
      - name: mimxrt1176
```

## west.yml
```yaml
# Copyright 2026 Theta Machines
# SPDX-License-Identifier: Apache-2.0

manifest:
  remotes:
    - name: zephyrproject
      url-base: https://github.com/zephyrproject-rtos

  projects:
    - name: zephyr
      remote: zephyrproject
      revision: v4.4.2
      import: true

  self:
    path: thetamachines
```
